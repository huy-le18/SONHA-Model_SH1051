;;;;;///*********************************************************************************************************//**
;;;;;// * @file    GLOBE_INCLUDE.INC
;;;;;// * @version V1.00
;;;;;// * @date    11/13/2020
;;;;;// * @brief   The header file of the GLOBE_INCLUDE library.
;;;;;// *************************************************************************************************************
;;;;;// * @attention
;;;;;// * <h2><center>Copyright (C) Best Solution Inc. All rights reserved</center></h2>
;;;;;// ************************************************************************************************************/

;;;;;///* ==================================================================================================================================================*/
;;;;;///** @addtogroup GLOBE_INCLUDE
;;;;;//  * @{
;;;;;//  */
;;;;;///* ---------------------------------------------------------------------------------------------------------*/
;;;;;///* Exported constants --------------------------------------------------------------------------------------*/
;;;;;///* ---------------------------------------------------------------------------------------------------------*/
;;;;;///** @defgroup GLOBE_INCLUDE_exported_constants GLOBE_INCLUDE exported constants
;;;;;//  * @{
;;;;;//  */

#define USER_PROGRAM_DEF
#include "..\GLOBE\GLOBE_VARIES.INC"
#include "..\GLOBE\GLOBE_INCLUDE.INC"



;;;;;//
;;;;;///**
;;;;;//  * @}
;;;;;//  */

;;;;;///* ---------------------------------------------------------------------- */
;;;;;///* assembly exported function,register                                    */
;;;;;///* ---------------------------------------------------------------------- */
;;;;;/*


;;;;;*/
;;;;;//--------------------------------------------------------------------------
;;;;;//--------------------------------------------------------------------------


;;;;;///* ---------------------------------------------------------------------- */
;;;;;///* C exported function,register                                           */
;;;;;///* ---------------------------------------------------------------------- */
;;;;;/*
ifdef _INCLUDE_C_
;;;;;*/
;;;;;//---------------------------------------------------------------


;;;;;//---------------------------------------------------------------
#ifdef  _CCV3_
;;;;;//-_CCV3_
#else
;;;;;//-_CCV2_
#endif

;;;;;//--------------------------------------------------------------------------
;;;;;//--------------------------------------------------------------------------
;;;;;/*
endif
;;;;;*/

;;;;;///* ---------------------------------------------------------------------- */
;;;;;///**
;;;;;//  * @}
;;;;;//  */
;;;;;///* ---------------------------------------------------------------------------------------------------------*/
;;;;;///**
;;;;;//  * @}
;;;;;//  */
;;;;;///* ==================================================================================================================================================*/

