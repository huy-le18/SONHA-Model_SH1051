;;;;;///*********************************************************************************************************//**
;;;;;// * @file    IIC_SLAVE.INC
;;;;;// * @version V1.00
;;;;;// * @date    11/13/2020
;;;;;// * @brief   The header file of the IIC_SLAVE library.
;;;;;// *************************************************************************************************************
;;;;;// * @attention
;;;;;// * <h2><center>Copyright (C) Best Solution Inc. All rights reserved</center></h2>
;;;;;// ************************************************************************************************************/

;;;;;///* Includes ------------------------------------------------------------------------------------------------*/
#define IIC_SLAVE_DEF
#include "..\GLOBE\GLOBE_VARIES.INC"
#include "..\GLOBE\GLOBE_INCLUDE.INC"
#include "IIC_SLAVE_HXT_CTOUCH_V512.DEF"

;;;;;///* ==================================================================================================================================================*/
;;;;;///** @addtogroup IIC_SLAVE
;;;;;//  * @{
;;;;;//  */
;;;;;///* ---------------------------------------------------------------------------------------------------------*/
;;;;;///* Exported functions --------------------------------------------------------------------------------------*/
;;;;;///* ---------------------------------------------------------------------------------------------------------*/
;;;;;///** @defgroup  IIC_SLAVE_exported_functions IIC_SLAVE exported functions
;;;;;//  * @{
;;;;;//  */
;;;;;//
;;;;;///* ---------------------------------------------------------------------- */
;;;;;///* assembly exported function,register                                    */
;;;;;///* ---------------------------------------------------------------------- */
;;;;;/*
;;;;;//-SUBROUTIN



;;;;;//-FLAG DEFINE
;;;;;*/
;;;;;////--------------------------------------------------------------------------
;;;;;//
;;;;;///* ---------------------------------------------------------------------- */
;;;;;///* C exported function,register                                           */
;;;;;///* ---------------------------------------------------------------------- */
;;;;;/*
ifdef _INCLUDE_C_
*/
//---------------------------------------------------------------
#define IIC_SLAVE_DEF

//---------------------------------------------------------------
#ifdef  _CCV3_
;;;;;//-_CCV3_
#else
;;;;;//-_CCV2_
#endif
//---------------------------------------------------------------
/*
endif
;;;;;*/


;;;;;///* ---------------------------------------------------------------------- */
;;;;;///**
;;;;;//  * @}
;;;;;//  */
;;;;;///* ---------------------------------------------------------------------------------------------------------*/
;;;;;///**
;;;;;//  * @}
;;;;;//  */
;;;;;///* ==================================================================================================================================================*/






