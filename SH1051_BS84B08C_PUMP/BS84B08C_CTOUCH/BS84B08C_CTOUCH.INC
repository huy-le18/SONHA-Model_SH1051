;;;;;///*********************************************************************************************************//**
;;;;;// * @file    BS84B08C_CTOUCH.INC
;;;;;// * @version V1.00
;;;;;// * @date    11/16/2020
;;;;;// * @brief   The header file of the BS84B08C_CTOUCH library.
;;;;;// *************************************************************************************************************
;;;;;// * @attention
;;;;;// * <h2><center>Copyright (C) Best Solution Inc. All rights reserved</center></h2>
;;;;;// ************************************************************************************************************/

;;;;;///* ==================================================================================================================================================*/
;;;;;///** @addtogroup BS84B08C_CTOUCH
;;;;;//  * @{
;;;;;//  */
;;;;;///* ---------------------------------------------------------------------------------------------------------*/
;;;;;//
;;;;;///* ---------------------------------------------------------------------------------------------------------*/
;;;;;///* Exported functions --------------------------------------------------------------------------------------*/
;;;;;///* ---------------------------------------------------------------------------------------------------------*/
;;;;;///** @defgroup  BS84B08C_CTOUCH include constants
;;;;;//  * @{
;;;;;//  */
;;;;;//

#define BS84B08C_CTOUCH_DEF
#include "..\GLOBE\GLOBE_VARIES.INC"
#include "..\MAIN_PROGRAM\MAIN_PROGRAM.EXT"
#include "BS84B08C_CTOUCH.DEF"

;;;;;///* --------------------------------------------------------------------- */
;;;;;///**
;;;;;//  * @}
;;;;;//  */
;;;;;///* ---------------------------------------------------------------------------------------------------------*/
;;;;;///**
;;;;;//  * @}
;;;;;//  */
;;;;;///* ==================================================================================================================================================*/



