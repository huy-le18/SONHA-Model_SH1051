;;;;;///*********************************************************************************************************//**
;;;;;// * @file    GLOBE_INCLUDE.INC
;;;;;// * @version V1.00
;;;;;// * @date    11/13/2020
;;;;;// * @brief   The header file of the GLOBE_INCLUDE library.
;;;;;// *************************************************************************************************************
;;;;;// * @attention
;;;;;// * <h2><center>Copyright (C) Best Solution Inc. All rights reserved</center></h2>
;;;;;// ************************************************************************************************************/
;;;;;///* ==================================================================================================================================================*/
;;;;;///** @addtogroup GLOBE_INCLUDE
;;;;;//  * @{
;;;;;//  */

;;;;;///* define ------------------------------------------------------------------------------------------------*/
#include    "..\BS84B08C_CTOUCH\BS84B08C_CTOUCH.EXT"
#include    "..\MAIN_PROGRAM\MAIN_PROGRAM.EXT"
#include    "..\USER_PROGRAM\USER_PROGRAM.EXT"
;//#include    "..\IIC_SLAVE\IIC_SLAVE.EXT"

;;;;;///* ---------------------------------------------------------------------------------------------------------*/
;;;;;///**
;;;;;//  * @}
;;;;;//  */
;;;;;///* ==================================================================================================================================================*/
































;;;;;///* ---------------------------------------------------------------------- */
;;;;;///**
;;;;;//  * @}
;;;;;//  */
;;;;;///* ---------------------------------------------------------------------------------------------------------*/
;;;;;///**
;;;;;//  * @}
;;;;;//  */
;;;;;///* ==================================================================================================================================================*/






